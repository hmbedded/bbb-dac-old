## Documentation/devicetree/bindings/sound/pcm512x.txt
```
PCM512x, PCM514x audio CODECs and TAS575x digital amps

The PCM51xx devices support both I2C and SPI (configured with pin strapping
on the board). The TAS575x devices only support I2C.

Required properties:

  - compatible : One of "ti,pcm5121", "ti,pcm5122", "ti,pcm5141", "ti,pcm5142",
                 "ti,tas5754m" or "ti,tas5756m"

  - reg : the I2C address of the device for I2C, the chip select
          number for SPI.

  - AVDD-supply, DVDD-supply, and CPVDD-supply : power supplies for the
    device, as covered in bindings/regulator/regulator.txt

Optional properties:

  - clocks : A clock specifier for the clock connected as SCLK.  If this
             is absent the device will be configured to clock from BCLK.

  - clock-type : 0 or 1 specifying the following:
                 0: SCLK is a multiple of the audio sampling rate.
                 1: SCLK is not a multiple of the audio sampling rate.

                 If absent clock type 0 is the default.

    If clock-type 1 is specified then some/all of the following properties are
    required:

  - pll-ref-gpio : GPIO input used for non audio related pll reference clock.
                   This is mandatory when using clock-type 1.

  - pll-out-gpio : GPIO output used to output the pll clock divided by 4. This
                   is mandatory when using clock-type 1.
  
  - pll-lock-gpio : GPIO output for the pll lock signal. This is optional.

Example:

	pcm5122: pcm5122@4c {
		compatible = "ti,pcm5122";
		reg = <0x4c>;

		AVDD-supply = <&reg_3v3_analog>;
		DVDD-supply = <&reg_1v8>;
		CPVDD-supply = <&reg_3v3>;
	};
```
